## Kconfig
```kconfig
menu "roBa Features"

config ROBA_DESKHOP_LAYER_SYNC
    bool "Sync layers from DeskHop output changes"
    depends on ZMK_HID_INDICATORS
    default n
    help
      Switch between two base layers whenever host HID indicator bits change.

if ROBA_DESKHOP_LAYER_SYNC

config ROBA_DESKHOP_LAYER_SYNC_LED_MASK
    hex "HID indicator mask used as sync signal"
    default 0x01
    help
      USB HID indicator bitmask used as DeskHop signal.
      0x01 corresponds to Num Lock.

config ROBA_DESKHOP_LAYER_WHEN_LED_ON
    int "Layer to select when sync indicator is ON"
    default 1

config ROBA_DESKHOP_LAYER_WHEN_LED_OFF
    int "Layer to select when sync indicator is OFF"
    default 0

config ROBA_DESKHOP_LAYER_SYNC_DEBUG_KEY
    bool "Type debug key on sync event"
    default n
    help
      Sends a key tap to the host whenever a HID indicator sync event is received.

config ROBA_DESKHOP_LAYER_SYNC_DEBUG_KEY_USAGE
    hex "Debug key HID usage id"
    default 0x1d
    help
      HID usage id for the debug key. 0x1d is KEYBOARD_Z.

endif

config ROBA_PERIPHERAL_BATTERY_LED
    bool "Peripheral battery low indicator LED"
    depends on ZMK_SPLIT_ROLE_CENTRAL && !ZMK_SPLIT_BLE_CENTRAL_BATTERY_LEVEL_FETCHING
    help
      Blink the red LED when a peripheral reports a low battery level.
      The ESB central raises peripheral_battery_state_changed itself and
      only does so while BLE's own battery-level fetching is disabled
      (see zmk-feature-split-esb central.c), so this depends on that
      Kconfig being off rather than on.

if ROBA_PERIPHERAL_BATTERY_LED

config ROBA_PERIPHERAL_BATTERY_LED_THRESHOLD
    int "Battery percentage threshold for low indicator"
    default 20
    help
      Blink the LED when a peripheral's battery is at or below this percentage.

config ROBA_LAYER_LED
    bool "Layer-based LED color indicator"
    help
      Show a continuous LED color based on the active keymap layer.
      Yellow (red+green) = Mac layer, Blue = Windows layer, Red = Gaming layer.
      Battery low blink takes priority and suppresses the layer color.

if ROBA_LAYER_LED

config ROBA_LAYER_LED_MAC_LAYER
    int "Mac base layer index"
    default 0

config ROBA_LAYER_LED_WIN_LAYER
    int "Windows layer index"
    default 1

config ROBA_LAYER_LED_GAME_LAYER
    int "Gaming layer index"
    default 2

endif # ROBA_LAYER_LED

endif

config ROBA_SELF_BATTERY_LED
    bool "Blink this device's own LED when its battery is low"
    depends on ZMK_BATTERY && !ZMK_SPLIT_ROLE_CENTRAL
    help
      On a split peripheral (e.g. the XIAO BLE keyboard halves) blink the
      onboard red LED (led0 alias) when this device's own battery drops to or
      below the threshold. Mirrors the low-battery indication lariska shows.

if ROBA_SELF_BATTERY_LED

config ROBA_SELF_BATTERY_LED_THRESHOLD
    int "Own-battery percentage threshold for low indicator"
    default 25
    help
      Blink the LED when this device's battery is at or below this percentage.
      Build a debug firmware with this set high (e.g. 95) to watch the blink
      behaviour without draining the battery.

endif # ROBA_SELF_BATTERY_LED

config ROBA_DONGLE_BATTERY_DISPLAY
    bool "Dongle OLED battery display for all peripherals"
    depends on ZMK_SPLIT_ROLE_CENTRAL && ZMK_DISPLAY && ZMK_BATTERY_REPORTING
    depends on ZMK_DISPLAY_STATUS_SCREEN_CUSTOM
    select LV_USE_LABEL
    select LV_USE_ARC
    select LV_USE_LINE
    select LV_USE_THEME_MONO
    help
      Custom OLED status screen showing battery % for the dongle and each
      peripheral (Left, Right, and optionally Mouse when PERIPHERAL_COUNT=3).
      Replaces the default built-in ZMK status screen.

if ROBA_DONGLE_BATTERY_DISPLAY
endif # ROBA_DONGLE_BATTERY_DISPLAY

config ROBA_ESB_PERIPHERAL_DISPLAY_COMPAT
    bool
    default y if ZMK_SPLIT_ESB && ZMK_SPLIT && !ZMK_SPLIT_ROLE_CENTRAL && ZMK_DISPLAY && !ZMK_SPLIT_BLE
    help
      Provide zmk_split_bt_peripheral_is_connected() on ESB split peripherals
      with a display, so BLE-oriented peripheral status screens (nice!view
      widgets) link. ESB is connectionless, so it always reports connected.

config ROBA_ESB_CENTRAL_DISPLAY_COMPAT
    bool
    default y if ZMK_SPLIT_ESB && ZMK_SPLIT_ROLE_CENTRAL && !ZMK_SPLIT_BLE && \
                 SHIELD_PROSPECTOR_ADAPTER
    help
      Re-raise the ESB transport's zmk_split_esb_peripheral_changed as
      zmk_split_central_status_changed, the event central-side display widgets
      (prospector-zmk-module's battery bar / circles / label) subscribe to for
      per-peripheral connection state. Only that module's BLE observer raises
      it, so without this the connection indicators never leave "disconnected".

      Gated on SHIELD_PROSPECTOR_ADAPTER, not just ZMK_DISPLAY: the event is
      declared and implemented by prospector-zmk-module, and it only builds
      those sources under its own shield. A plain ZMK_DISPLAY condition also
      caught the nice!nano OLED dongle, where raise_* is then undefined at
      link.

if ROBA_ESB_CENTRAL_DISPLAY_COMPAT

config ROBA_ESB_CENTRAL_DISPLAY_POLL_MS
    int "Period for re-asserting peripheral state into the display widgets"
    default 1000
    help
      The battery widgets keep connection state inside their LVGL objects,
      cannot query the transport, and drop anything raised before the status
      screen exists. So poll zmk_split_esb_peer_battery() /
      zmk_split_esb_peer_rssi_dbm() and re-assert on change, the way
      src/dongle_battery_display.c drives the OLED dongle. Self-healing: a
      missed edge, a late screen or a rebuilt widget converge within one
      period. Matches that screen's 1 s cadence.

endif

# ZMK declares this inside `if ZMK_SPLIT && ZMK_SPLIT_BLE` (app/src/split/
# bluetooth/Kconfig), so on an ESB-only central the symbol does not exist --
# and ZMK_SPLIT_BLE_PERIPHERAL_COUNT in app/include/zmk/ble.h expands to it
# verbatim. Display widgets size their per-peripheral arrays with that macro,
# so they fail to compile. Declare it unconditionally and let the ESB pipe
# count drive it. Harmless when BLE split is on: ZMK's own declaration adds
# the prompt back and this default stays out of the way.
config ZMK_SPLIT_BLE_CENTRAL_PERIPHERALS
    int
    default 3 if ZMK_SPLIT_ESB && !ZMK_SPLIT_BLE

config ROBA_PROSPECTOR_SCREEN
    bool "Custom Prospector status screen"
    depends on ZMK_DISPLAY && ZMK_SPLIT_ESB && ZMK_SPLIT_ROLE_CENTRAL
    depends on PROSPECTOR_STATUS_SCREEN_NONE
    select LV_USE_LABEL
    select LV_USE_ARC
    help
      Base layer, one battery+signal dial per ESB peripheral, and the hop
      channel. Replaces prospector-zmk-module's status screens, so it needs
      PROSPECTOR_STATUS_SCREEN_NONE -- otherwise both define
      zmk_display_status_screen() and collide at link.

      Polls the transport rather than subscribing to events. The module's own
      widgets are event-driven and cannot be queried, which means a value that
      changes before the screen exists is lost for good; polling converges
      regardless of boot ordering.

if ROBA_PROSPECTOR_SCREEN

config ROBA_PROSPECTOR_SCREEN_POLL_MS
    int "Redraw period"
    default 250
    help
      How often poll_fn() re-reads the transport and marks the widgets dirty.
      This is the whole screen's update rate -- layer included, since nothing
      here redraws on an event. At the OLED dongle's old 1 s cadence a layer
      tap took up to a second to show on screen, which read as a laggy panel.

      Cost is one dirty-rect redraw of the labels and dials per tick, not a
      full frame, so 250 ms is still far under what the panel can flush
      (240x280 at 16bpp over 30 MHz SPI is ~36 ms for a *full* screen). Lower
      it to 100 for a near-instant layer indicator if the ESB pointer jitter
      that buys is acceptable -- the LVGL flush thread runs at cooperative
      priority -1 and will not yield to the ESB central thread mid-flush.

config ROBA_PROSPECTOR_SCREEN_RAW_FOOTER
    bool "Show raw transport values in the footer (diagnostic)"
    default n
    help
      Replaces the link-health line with the bytes zmk_split_esb_peer_battery()
      and zmk_split_esb_peer_rssi_dbm() actually return, per pipe. FF means the
      transport reports battery unknown, which distinguishes "no value on the
      wire" from "this screen is mishandling a value it was given".

# --- macOS theme ---------------------------------------------------------
#
# iOS dark-mode system colours. The battery ring is semantic -- green, then
# yellow at 20%, then red at 10%, the same ladder the iOS Batteries widget
# uses -- so the accent is not a brand colour to be picked freely.
#
# These names are unprefixed for history's sake: they were the only palette
# before the screen learned to theme per OS. They are the macOS set.
config ROBA_PROSPECTOR_SCREEN_BG
    hex "Background"
    default 0x000000
    help
      True black, as an iOS widget on a dark home screen. Also the cheapest
      colour on an OLED-style panel.

config ROBA_PROSPECTOR_SCREEN_PRIMARY
    hex "Primary text"
    default 0xFFFFFF

config ROBA_PROSPECTOR_SCREEN_SECONDARY
    hex "Secondary text (systemGray)"
    default 0x8E8E93

config ROBA_PROSPECTOR_SCREEN_GOOD
    hex "Battery healthy (systemGreen)"
    default 0x30D158

config ROBA_PROSPECTOR_SCREEN_WARN
    hex "Battery low (systemYellow)"
    default 0xFFD60A

config ROBA_PROSPECTOR_SCREEN_CRIT
    hex "Battery critical (systemRed)"
    default 0xFF453A

config ROBA_PROSPECTOR_SCREEN_SIGNAL
    hex "Signal ring (systemBlue)"
    default 0x0A84FF

config ROBA_PROSPECTOR_SCREEN_TRACK
    hex "Ring track (systemGray5)"
    default 0x2C2C2E

config ROBA_PROSPECTOR_SCREEN_BARS_TRACK
    hex "Unlit signal bar (systemGray3)"
    default 0x48484A
    help
      Brighter than the ring track on purpose. Both started on systemGray5,
      which a 12 px arc stroke carries happily and a 4 px bar does not -- the
      unlit bars were so close to black that a link dropping from four bars to
      two just looked like bars vanishing, with nothing left to say how far it
      had fallen. systemGray3 keeps the ghost bars legible as the unfilled
      remainder while staying well clear of the lit colour.

# --- Windows theme: Teal & Silver ----------------------------------------
#
# Windows 95/98's desktop teal and a true neutral silver -- the two colours
# anyone who used a beige PC remembers first. Picked over the more literal
# options (Fluent, the brand's four squares) because the thing that actually
# separates two themes on this screen is the *neutrals*, not the accent: the
# secondary grey paints the subtitle and both footer lines, and the ring track
# paints three full rings, which between them cover more pixels than every
# semantic colour combined. Apple's systemGray is faintly warm; a true silver
# sits in direct opposition to it, and no blue appears anywhere.
#
# The background stays true black in both themes, so switching OS never
# repaints the whole panel and the bezel edge stays invisible.
config ROBA_PROSPECTOR_WIN_PRIMARY
    hex "Windows: primary text"
    default 0xE8E8E8

config ROBA_PROSPECTOR_WIN_SECONDARY
    hex "Windows: secondary text (silver)"
    default 0xA8A8A8

config ROBA_PROSPECTOR_WIN_GOOD
    hex "Windows: battery healthy"
    default 0x3CB054
    help
      Warmer than the period-correct 0x00A850. That green and the teal signal
      colour are both cyan-greens roughly 25 degrees of hue apart, and the
      signal bars sit directly beneath the ring they would be confused with.
      Nudging healthy toward true green opens the gap. Set it back to 0x00A850
      for the authentic pairing if the two read clearly on the panel.

config ROBA_PROSPECTOR_WIN_WARN
    hex "Windows: battery low"
    default 0xE0C000

config ROBA_PROSPECTOR_WIN_CRIT
    hex "Windows: battery critical"
    default 0xD04030

config ROBA_PROSPECTOR_WIN_SIGNAL
    hex "Windows: signal bars (teal)"
    default 0x00B3B3

config ROBA_PROSPECTOR_WIN_TRACK
    hex "Windows: ring track"
    default 0x2A2A2A

config ROBA_PROSPECTOR_WIN_BARS_TRACK
    hex "Windows: unlit signal bar"
    default 0x4E4E4E

config ROBA_PROSPECTOR_SCREEN_WARN_PCT
    int "Battery percentage that turns the ring yellow"
    default 20

config ROBA_PROSPECTOR_SCREEN_CRIT_PCT
    int "Battery percentage that turns the ring red"
    default 10

# Gaming mode: a second widget tree on the same screen, shown while the gaming
# base layer is held. Battery, OS and layer all come off -- you chose the layer
# and the batteries were fine a minute ago, whereas the link is the one thing
# that can still go wrong mid-match -- leaving three segmented RSSI meters.
#
# Its own palette rather than the iOS semantic one above. The ladder means the
# same thing (healthy / marginal / bad) but systemGreen next to a row of HP
# bars reads as a settings screen, and this is the one screen that is allowed
# to look like a game.
config ROBA_PROSPECTOR_GAMING_GOOD
    hex "Gaming meter, healthy"
    default 0x5BE000

config ROBA_PROSPECTOR_GAMING_WARN
    hex "Gaming meter, marginal"
    default 0xFFC400

config ROBA_PROSPECTOR_GAMING_CRIT
    hex "Gaming meter, bad"
    default 0xFF3B2F

config ROBA_PROSPECTOR_GAMING_TRACK
    hex "Gaming meter, unlit segment"
    default 0x2C3A18
    help
      Dim olive rather than near-black, for the same reason the signal bars
      have their own track: the unfilled remainder is what makes a part-filled
      meter legible as a fraction instead of a bar of arbitrary length.

config ROBA_PROSPECTOR_GAMING_RSSI_TOP
    int "dBm that fills the gaming meter"
    default -50

config ROBA_PROSPECTOR_GAMING_RSSI_FLOOR
    int "dBm that empties the gaming meter"
    default -90
    help
      The meter interpolates between floor and top across its twelve segments,
      so it resolves about 3.3 dB per segment -- far finer than the four-bar
      antenna glyph on the base screen, which is the point of showing it this
      way. Any live sample above the floor keeps at least one segment lit, so
      a weak link never looks identical to a dead one.

endif # ROBA_PROSPECTOR_SCREEN

config ROBA_PROSPECTOR_I2C_PROBE
    bool "Scan i2c1 and log every responder (diagnostic)"
    depends on I2C
    default n
    help
      Answers whether the Prospector's touch panel is reachable. The adapter
      devicetree declares no touch controller, but the hardware ships a panel
      that has a digitizer, so the question is purely whether the PCB routes
      TP_SDA/TP_SCL to the i2c1 the light sensor already uses. A CST816S
      answers at 0x15; if only 0x39 (the APDS9960) replies, touch is not wired
      and input has to come from that sensor's gesture engine instead.
      Needs a log backend -- build with roBakesb_prospector_probe.conf.

if ROBA_PROSPECTOR_I2C_PROBE

config ROBA_PROSPECTOR_I2C_PROBE_DELAY_MS
    int "Delay before the first scan"
    default 4000
    help
      Long enough for USB CDC to enumerate, so the first scan is not logged
      into a console nobody has opened yet.

config ROBA_PROSPECTOR_I2C_PROBE_PERIOD_MS
    int "Period between repeat scans"
    default 8000
    help
      The scan repeats so the result appears within one period of attaching the
      console, rather than only once at boot.

endif # ROBA_PROSPECTOR_I2C_PROBE

config ROBA_VFX_RETRO_ESB_LINK
    bool "Feed ESB link stats into the vfx-retro status screen"
    depends on VFX_RETRO && ZMK_SPLIT_ESB && !ZMK_SPLIT_ROLE_CENTRAL
    default y
    help
      Override zmk-vfx-retro's __weak vfx_retro_link_get() so the retro
      pixel-art status screen shows this peripheral's real central-link RSSI
      and hop channel, read from the damex zmk-feature-split-esb transport
      (zmk_split_esb_get_status), instead of the module's placeholder values.

config ROBA_PMW3610_PERIPHERAL_KEYMAP_COMPAT
    bool "PMW3610 split peripheral keymap compatibility"
    depends on ZMK_SPLIT && !ZMK_SPLIT_ROLE_CENTRAL
    default n
    help
      Let the PMW3610 driver link on split peripherals by returning the
      default layer for its layer-mode query. Split peripherals do not own
      ZMK keymap state, so layer-based PMW3610 modes cannot be evaluated
      there; the central still processes the shared keymap.

config ROBA_INPUT_PROCESSOR_CIRQUE_GESTURES
    bool "Cirque absolute-mode right-edge scroll input processor"
    depends on ZMK_POINTING
    default n
    help
      Convert absolute Cirque Pinnacle X/Y reports to relative pointer motion,
      and turn touches that start in the right-side zone into vertical wheel
      events. This fills the right-side vertical scroll gesture planned by
      zmk-input-gestures for the Corne Cirque peripheral.

config ROBA_INPUT_PROCESSOR_TAP_CLICK
    bool "Sync-preserving tap-to-click input processor"
    default y
    depends on DT_HAS_ROBA_INPUT_PROCESSOR_TAP_CLICK_ENABLED
    depends on ZMK_POINTING
    help
      Invoke a behavior on transitions of one key code (e.g. the Cirque
      pinnacle's BTN_TOUCH tap gesture) while letting the event's sync flag
      continue to the input listener. zmk,input-processor-behaviors returns
      STOP, which drops the sync carried on BTN_TOUCH and freezes all
      pointer motion from the trackpad.

config ROBA_BEHAVIOR_AUTOCLICK
    bool "Latching auto-clicker behavior"
    default y
    depends on DT_HAS_ROBA_BEHAVIOR_AUTOCLICK_ENABLED
    depends on ZMK_POINTING
    depends on !ZMK_SPLIT || ZMK_SPLIT_ROLE_CENTRAL
    help
      One press starts clicking a HID mouse button on a timer and keeps going
      hands-free; pressing the same key again, or any other key, stops it.
      Only the central owns the keymap, so the clicker is built there.

endmenu
```
