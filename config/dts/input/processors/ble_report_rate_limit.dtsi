#include <zephyr/dt-bindings/input/input-event-codes.h>

/ {
    /omit-if-no-ref/ roba_ble_report_rate_limit: roba_ble_report_rate_limit {
        compatible = "roba,input-processor-ble-report-rate-limit";
        #input-processor-cells = <1>;
        type = <INPUT_EV_REL>;
        codes = <INPUT_REL_X INPUT_REL_Y>;
    };
};
