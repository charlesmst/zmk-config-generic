/*
 * Keychron B1 Pro (US/ANSI) as extra positions on the shared roBakesb matrix.
 *
 * Positions 48-124 of the global keymap: the 48 roBa + lariska positions from
 * roBakesb_lariska_transform.dtsi come first and are untouched, so every
 * binding already written for them keeps its index. Include this file in the
 * dongle (via the roBakesb_keychron_link shield), in the other peripherals
 * (same shield) and in the Keychron peripheral itself, so all of them agree on
 * the matrix.
 *
 * Matrix. The keyboard's own 8 row x 18 column matrix is copied verbatim from
 * Keychron's 2025 shield (Keychron/zmk keychron_bpro, keychron_b1_usn.overlay),
 * the same numbers as the board's own transform, which is where they were
 * checked against a stock image (boards/keychron/keychron_b1_pro). The
 * roBa halves already own rows 0-3 of the shared matrix, so the Keychron
 * peripheral sets row-offset = 4 and its kscan row r lands on shared row
 * r + 4. That is the only translation; the numbers below are Keychron's.
 *
 * Order. Row by row, left to right, same as the keycaps; the arrows are last
 * in the bottom row as left, up, down, right. The slide switches and charge pins
 * Keychron's firmware also exposes as "keys" are not positions here.
 *
 * Also defines ROBA_KEYCHRON, which is what roBakesb.keymap tests to decide
 * whether each layer carries these positions' bindings. The keymap is
 * preprocessed in the same cpp run as the overlays, after them, so the define
 * is visible to it; see roBakesb_keychron.h.
 *
 * Studio geometry is approximate: the block sits under the roBa, in key units
 * of 100, and exists so Studio can draw the extra positions.
 */

#include <dt-bindings/zmk/matrix_transform.h>
#include "roBakesb_lariska_transform.dtsi"

#ifndef ROBA_KEYCHRON
#define ROBA_KEYCHRON 1
#endif

#define ROBA_KEYCHRON_ROW_OFFSET 4
#define KC_RC(r, c) RC((r) + ROBA_KEYCHRON_ROW_OFFSET, c)

#ifndef ROBA_KEYCHRON_MAP
#define ROBA_KEYCHRON_MAP \
    /* Row 0: Esc, F1-F12, Del */ \
    KC_RC(7,5) KC_RC(1,2) KC_RC(3,4) KC_RC(1,14) KC_RC(1,4) KC_RC(2,2) KC_RC(4,2) KC_RC(2,5) KC_RC(2,6) KC_RC(2,7) KC_RC(2,10) KC_RC(2,8) KC_RC(3,7) KC_RC(5,8) \
    /* Row 1: number row */ \
    KC_RC(0,17) KC_RC(1,0) KC_RC(1,15) KC_RC(1,1) KC_RC(3,6) KC_RC(1,12) KC_RC(1,13) KC_RC(5,5) KC_RC(5,6) KC_RC(5,7) KC_RC(5,10) KC_RC(1,6) KC_RC(1,7) KC_RC(1,8) \
    /* Row 2: Tab row */ \
    KC_RC(0,5) KC_RC(0,10) KC_RC(0,8) KC_RC(0,9) KC_RC(0,13) KC_RC(0,14) KC_RC(3,5) KC_RC(3,1) KC_RC(1,3) KC_RC(2,4) KC_RC(1,11) KC_RC(4,6) KC_RC(4,7) KC_RC(4,10) \
    /* Row 3: home row */ \
    KC_RC(5,17) KC_RC(0,4) KC_RC(0,6) KC_RC(0,7) KC_RC(0,2) KC_RC(1,17) KC_RC(6,8) KC_RC(1,10) KC_RC(3,2) KC_RC(1,9) KC_RC(6,5) KC_RC(6,7) KC_RC(2,1) \
    /* Row 4: shift row */ \
    KC_RC(0,16) KC_RC(0,0) KC_RC(0,15) KC_RC(0,1) KC_RC(0,12) KC_RC(0,11) KC_RC(7,6) KC_RC(7,11) KC_RC(7,10) KC_RC(7,8) KC_RC(7,9) KC_RC(5,15) \
    /* Row 5: bottom row, arrows last (left, up, down, right) */ \
    KC_RC(1,5) KC_RC(3,10) KC_RC(6,17) KC_RC(0,3) KC_RC(4,0) KC_RC(2,9) KC_RC(3,17) KC_RC(2,17) KC_RC(4,17) KC_RC(7,17)
#endif

#ifndef ROBA_KEYCHRON_KEYS
#define ROBA_KEYCHRON_KEYS \
    /* Row 0: Esc, F1-F12, Del */ \
    &key_physical_attrs 100 100    0  600 0 0 0 \
    &key_physical_attrs 100 100  100  600 0 0 0 \
    &key_physical_attrs 100 100  200  600 0 0 0 \
    &key_physical_attrs 100 100  300  600 0 0 0 \
    &key_physical_attrs 100 100  400  600 0 0 0 \
    &key_physical_attrs 100 100  500  600 0 0 0 \
    &key_physical_attrs 100 100  600  600 0 0 0 \
    &key_physical_attrs 100 100  700  600 0 0 0 \
    &key_physical_attrs 100 100  800  600 0 0 0 \
    &key_physical_attrs 100 100  900  600 0 0 0 \
    &key_physical_attrs 100 100 1000  600 0 0 0 \
    &key_physical_attrs 100 100 1100  600 0 0 0 \
    &key_physical_attrs 100 100 1200  600 0 0 0 \
    &key_physical_attrs 100 100 1300  600 0 0 0 \
    /* Row 1: number row */ \
    &key_physical_attrs 100 100    0  700 0 0 0 \
    &key_physical_attrs 100 100  100  700 0 0 0 \
    &key_physical_attrs 100 100  200  700 0 0 0 \
    &key_physical_attrs 100 100  300  700 0 0 0 \
    &key_physical_attrs 100 100  400  700 0 0 0 \
    &key_physical_attrs 100 100  500  700 0 0 0 \
    &key_physical_attrs 100 100  600  700 0 0 0 \
    &key_physical_attrs 100 100  700  700 0 0 0 \
    &key_physical_attrs 100 100  800  700 0 0 0 \
    &key_physical_attrs 100 100  900  700 0 0 0 \
    &key_physical_attrs 100 100 1000  700 0 0 0 \
    &key_physical_attrs 100 100 1100  700 0 0 0 \
    &key_physical_attrs 100 100 1200  700 0 0 0 \
    &key_physical_attrs 200 100 1300  700 0 0 0 \
    /* Row 2: Tab row */ \
    &key_physical_attrs 150 100    0  800 0 0 0 \
    &key_physical_attrs 100 100  150  800 0 0 0 \
    &key_physical_attrs 100 100  250  800 0 0 0 \
    &key_physical_attrs 100 100  350  800 0 0 0 \
    &key_physical_attrs 100 100  450  800 0 0 0 \
    &key_physical_attrs 100 100  550  800 0 0 0 \
    &key_physical_attrs 100 100  650  800 0 0 0 \
    &key_physical_attrs 100 100  750  800 0 0 0 \
    &key_physical_attrs 100 100  850  800 0 0 0 \
    &key_physical_attrs 100 100  950  800 0 0 0 \
    &key_physical_attrs 100 100 1050  800 0 0 0 \
    &key_physical_attrs 100 100 1150  800 0 0 0 \
    &key_physical_attrs 100 100 1250  800 0 0 0 \
    &key_physical_attrs 150 100 1350  800 0 0 0 \
    /* Row 3: home row */ \
    &key_physical_attrs 175 100    0  900 0 0 0 \
    &key_physical_attrs 100 100  175  900 0 0 0 \
    &key_physical_attrs 100 100  275  900 0 0 0 \
    &key_physical_attrs 100 100  375  900 0 0 0 \
    &key_physical_attrs 100 100  475  900 0 0 0 \
    &key_physical_attrs 100 100  575  900 0 0 0 \
    &key_physical_attrs 100 100  675  900 0 0 0 \
    &key_physical_attrs 100 100  775  900 0 0 0 \
    &key_physical_attrs 100 100  875  900 0 0 0 \
    &key_physical_attrs 100 100  975  900 0 0 0 \
    &key_physical_attrs 100 100 1075  900 0 0 0 \
    &key_physical_attrs 100 100 1175  900 0 0 0 \
    &key_physical_attrs 225 100 1275  900 0 0 0 \
    /* Row 4: shift row */ \
    &key_physical_attrs 225 100    0 1000 0 0 0 \
    &key_physical_attrs 100 100  225 1000 0 0 0 \
    &key_physical_attrs 100 100  325 1000 0 0 0 \
    &key_physical_attrs 100 100  425 1000 0 0 0 \
    &key_physical_attrs 100 100  525 1000 0 0 0 \
    &key_physical_attrs 100 100  625 1000 0 0 0 \
    &key_physical_attrs 100 100  725 1000 0 0 0 \
    &key_physical_attrs 100 100  825 1000 0 0 0 \
    &key_physical_attrs 100 100  925 1000 0 0 0 \
    &key_physical_attrs 100 100 1025 1000 0 0 0 \
    &key_physical_attrs 100 100 1125 1000 0 0 0 \
    &key_physical_attrs 175 100 1225 1000 0 0 0 \
    /* Row 5: bottom row, arrows last (left, up, down, right) */ \
    &key_physical_attrs 125 100    0 1100 0 0 0 \
    &key_physical_attrs 125 100  125 1100 0 0 0 \
    &key_physical_attrs 125 100  250 1100 0 0 0 \
    &key_physical_attrs 625 100  375 1100 0 0 0 \
    &key_physical_attrs 100 100 1000 1100 0 0 0 \
    &key_physical_attrs 100 100 1100 1100 0 0 0 \
    &key_physical_attrs 100 100 1225 1100 0 0 0 \
    &key_physical_attrs 100  50 1325 1100 0 0 0 \
    &key_physical_attrs 100  50 1325 1150 0 0 0 \
    &key_physical_attrs 100 100 1425 1100 0 0 0
#endif

&default_transform {
    rows = <12>;
    columns = <18>;
    map = <ROBA_LARISKA_MAP ROBA_KEYCHRON_MAP>;
};

&roba_physical_layout {
    keys = <ROBA_LARISKA_KEYS ROBA_KEYCHRON_KEYS>;
};

/* The Keychron's pipe. Enabling it changes the beacon every node parses (its
 * length is 4 + 2 per enabled peripheral), so left, right, lariska, the dongle
 * and the Keychron all have to be built with it. */
&esb_keychron {
    status = "okay";
};
