## boards/keychron/keychron_b1_pro/board.yml
```yaml
board:
  name: keychron_b1_pro
  full_name: Keychron B1 Pro
  vendor: keychron
  socs:
  - name: nrf52840
```

## config/boards/arm/keychron_b1_pro/Kconfig.board
```kconfig
config BOARD_KEYCHRON_B1_PRO
    bool "keychron_b1_pro"
    depends on SOC_SERIES_NRF52
```

## config/boards/shields/charybdis_esb/Kconfig.defconfig
```kconfig
if SHIELD_CHARYBDIS_ESB

config ZMK_KEYBOARD_NAME
    default "Charybdis ESB"

config ZMK_SPLIT
    default y

endif # SHIELD_CHARYBDIS_ESB

if SHIELD_CHARYBDIS_ESB_LEFT

config ZMK_KEYBOARD_NAME
    default "Charybdis ESB L"

config ZMK_SPLIT
    default y

endif # SHIELD_CHARYBDIS_ESB_LEFT

if SHIELD_CHARYBDIS_ESB_RIGHT

config ZMK_KEYBOARD_NAME
    default "Charybdis ESB R"

config ZMK_SPLIT
    default y

endif # SHIELD_CHARYBDIS_ESB_RIGHT

if SHIELD_CHARYBDIS_ESB_LARISKA

config ZMK_KEYBOARD_NAME
    default "Charybdis ESB Lariska"

config ZMK_SPLIT
    default y

endif # SHIELD_CHARYBDIS_ESB_LARISKA

if SHIELD_CHARYBDIS_ESB_RIGHT_CENTRAL

config ZMK_KEYBOARD_NAME
    default "Charybdis ESB"

config ZMK_SPLIT
    default y

endif # SHIELD_CHARYBDIS_ESB_RIGHT_CENTRAL

if SHIELD_CHARYBDIS_ESB_RELAY

config ZMK_KEYBOARD_NAME
    default "Charybdis ESB Relay"

config ZMK_SPLIT
    default y

endif # SHIELD_CHARYBDIS_ESB_RELAY
```

## config/dts/bindings/behaviors/roba,behavior-autoclick.yaml
```yaml
# Copyright (c) 2026 The ZMK Contributors
# SPDX-License-Identifier: MIT

description: |
  Latching auto-clicker. One press starts clicking a HID button over and over
  on a timer and keeps going hands-free; the next press of the same key, or a
  press of any other key position, stops it.

  Param1 is a HID button bit mask, same shape as &mkp: LCLK=BIT(0),
  RCLK=BIT(1), MCLK=BIT(2), MB4=BIT(3), MB5=BIT(4), OR'd for multiple.

  A ZMK macro cannot do this: macros run a fixed number of steps and hold the
  behavior queue while they do, so a long click burst would freeze the rest of
  the keyboard. This drives the clicks from a work item instead, so the
  keyboard stays live while it runs.

compatible: "roba,behavior-autoclick"

include: one_param.yaml

properties:
  click-device:
    type: phandle
    required: true
    description: |
      Input device the clicks are reported on, as BTN_0.. key events. Point it
      at ZMK's &mkp: the clicks then take the same input-listener path as a
      mouse-key press, which is the path the ESB HID relay taps. Writing
      zmk_hid directly instead would reach the local host only.
  press-ms:
    type: int
    default: 20
    description: Milliseconds the button is held down for each click.
  interval-ms:
    type: int
    default: 20
    description: Milliseconds between the release of one click and the next press.
```

## config/dts/bindings/behaviors/roba,behavior-layer-key-press.yaml
```yaml
# Copyright (c) 2026 The ZMK Contributors
# SPDX-License-Identifier: MIT

description: |
  A key press that sends param1, or param2 while `layer` is active. Written
  for one Fn layer shared by Mac and Windows: `&os_kp C_AC_SEARCH LG(S)` is
  Spotlight on the Mac and Search on Windows, keyed off the Windows base
  layer that DeskHop turns on.

  The key released is always the one that was pressed, even if the layer
  changed while the key was held.

compatible: "roba,behavior-layer-key-press"

include: two_param.yaml

properties:
  layer:
    type: int
    required: true
    description: Layer whose being active selects param2 over param1.
```

## config/dts/bindings/behaviors/roba,behavior-switch-layer.yaml
```yaml
# Copyright (c) 2026 The ZMK Contributors
# SPDX-License-Identifier: MIT

description: |
  A slide switch read as a held key, keeping then-layer on whenever the switch
  is on and if-layer is active.

  Bind it to the switch's key position. Pressed means the switch is on,
  released means it is off. The behavior remembers that itself rather than
  holding a layer for it, so nothing that rewrites the layer stack (&to, a
  DeskHop host switch, the dongle restarting) can forget the switch: on every
  layer change it checks again, and turns then-layer back on if if-layer is
  active and then-layer is not.

  Turning the switch off turns then-layer off, but only if this behavior was
  the one keeping it on. Leaving if-layer with the switch still on (another
  host, or a &to elsewhere) leaves then-layer to whoever changed the layers.

compatible: "roba,behavior-switch-layer"

include: zero_param.yaml

properties:
  if-layer:
    type: int
    required: true
    description: Layer that has to be active for the switch to apply.
  then-layer:
    type: int
    required: true
    description: Layer kept on while the switch is on and if-layer is active.
```
