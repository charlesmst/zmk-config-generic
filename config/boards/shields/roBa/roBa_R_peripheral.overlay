#include "roBa.dtsi"
#include "roBa_R_trackball.dtsi"
#include <input/processors/xyz.dtsi>

&default_transform {
    col-offset = <6>;
};

&kscan0 {
        col-gpios
            = <&xiao_d 10 GPIO_ACTIVE_HIGH>
            , <&xiao_d 9 GPIO_ACTIVE_HIGH>
            , <&xiao_d 8 GPIO_ACTIVE_HIGH>
            , <&xiao_d 7 GPIO_ACTIVE_HIGH>
            , <&gpio0 10 GPIO_ACTIVE_HIGH>
            ;
};

&trackball_split {
    status = "okay";
    device = <&trackball>;
    input-processors = <&zip_xyz>;
};
