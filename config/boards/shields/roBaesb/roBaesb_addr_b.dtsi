/ {
    esb_split {
        compatible = "zmk,esb-split";
        base-addr-0 = <0xA8 0x3F 0x6D 0xC2>;
        base-addr-1 = <0x51 0xE9 0x14 0x7B>;
        addr-prefix = <0x2F 0x8A 0xC4 0x61 0xD7 0x3E 0x95 0xB0>;
    };
};
