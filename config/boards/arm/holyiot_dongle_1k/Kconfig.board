## config/dts/bindings/input/roba,input-processor-cirque-gestures.yaml
```yaml
# Copyright 2026 Charles Stein
# SPDX-License-Identifier: MIT

description: Cirque absolute-mode pointer and right-edge scroll processor

compatible: "roba,input-processor-cirque-gestures"

include: base.yaml

properties:
  "#input-processor-cells":
    type: int
    required: true
    const: 0

  width:
    type: int
    default: 1024
    description: Scaled absolute X range used to find the right-side scroll zone.

  height:
    type: int
    default: 1024
    description: Scaled absolute Y range used for circular edge-start scrolling.

  right-scroll-percent:
    type: int
    default: 18
    description: Width of the right-side vertical scroll zone, as a percentage.

  scroll-divisor:
    type: int
    default: 80
    description: Absolute Y units per emitted REL_WHEEL tick.

  circular-scroll-degrees-per-tick:
    type: int
    default: 12
    description: Angular degrees per emitted REL_WHEEL tick after scroll starts on the right edge.

  edge-scroll-activation-threshold:
    type: int
    default: 18
    description: Initial absolute movement needed before a right-edge touch commits to scroll or pointer.

  edge-scroll-tangent-percent:
    type: int
    default: 125
    description: Minimum tangential-to-radial movement percentage required to commit right-edge scroll.

  edge-scroll-recover-threshold:
    type: int
    default: 24
    description: Movement needed before an active scroll gesture can recover back to pointer mode.

  edge-scroll-recover-radial-percent:
    type: int
    default: 150
    description: Minimum radial-to-tangential movement percentage required to recover scroll to pointer.

  pointer-deadzone:
    type: int
    default: 0
    description: Absolute movement units to absorb before emitting normal pointer motion.

  pointer-multiplier:
    type: int
    default: 1
    description: Numerator for absolute delta to relative pointer movement.

  pointer-divisor:
    type: int
    default: 1
    description: Denominator for absolute delta to relative pointer movement.

  touch-timeout-ms:
    type: int
    default: 50
    description: Time without absolute X/Y reports after which a touch is considered ended.

  invert-scroll:
    type: boolean
    description: Invert right-side vertical scroll direction.

  invert-y:
    type: boolean
    description: Invert normal pointer Y movement after absolute-to-relative conversion.

  tap-click:
    type: boolean
    description: Emit a left click for a short touch with little movement.

  suppress-movement-during-tap:
    type: boolean
    description: Suppress pointer movement while a touch is still inside the tap dead zone.

  tap-timeout-ms:
    type: int
    default: 180
    description: Maximum touch duration, including touch-timeout-ms, to treat as a tap.

  tap-move-threshold:
    type: int
    default: 35
    description: Maximum absolute movement on either axis to still treat a touch as a tap.
```

## config/dts/bindings/input_processors/roba,input-processor-ble-report-rate-limit.yaml
```yaml
description: BLE-only relative input report rate limiter.

compatible: "roba,input-processor-ble-report-rate-limit"

include: base.yaml

properties:
  "#input-processor-cells":
    type: int
    required: true
    const: 1

  type:
    type: int
    default: 2
    description: Input event type to limit.

  codes:
    type: array
    required: true
    description: Input event codes to limit.

  track-remainders:
    type: boolean
    description: Processor handles sub-pixel carry internally.

input-processor-cells:
  - delay-ms
```

## config/dts/bindings/input_processors/roba,input-processor-tap-click.yaml
```yaml
# Copyright (c) 2026 The ZMK Contributors
# SPDX-License-Identifier: MIT

description: |
  Sync-preserving tap-to-click input processor. Invokes a behavior on
  transitions of one key code (e.g. BTN_TOUCH from a Cirque trackpad) and
  then neutralizes the event instead of consuming it, so a sync flag carried
  on that event still reaches the input listener's flush.

  zmk,input-processor-behaviors is unusable for this: it returns STOP, and
  input_listener drops STOPped events before the sync flush. The Cirque
  pinnacle driver in relative mode with primary-tap-enable puts sync ONLY on
  the BTN_TOUCH event of every packet, so STOPping it freezes all pointer
  motion.

compatible: "roba,input-processor-tap-click"

include: ip_zero_param.yaml

properties:
  code:
    type: int
    required: true
  bindings:
    type: phandle-array
    required: true
```
