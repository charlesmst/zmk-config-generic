## config/boards/arm/holyiot_dongle_1k/Kconfig.board
```kconfig
config BOARD_HOLYIOT_DONGLE_1K
    bool "holyiot_dongle_1k"
    depends on SOC_SERIES_NRF52
```

## config/boards/arm/holyiot_dongle_1k/Kconfig.defconfig
```kconfig
# SPDX-License-Identifier: MIT

if BOARD_HOLYIOT_DONGLE_1K

config BOARD
    default "holyiot_dongle_1k"

config SOC_NRF52840_QIAA
    default y

config USB_NRFX
    default y

config USB_DEVICE_STACK
    default y

endif # BOARD_HOLYIOT_DONGLE_1K
```

## config/boards/arm/holyiot_dongle_1k/board.yml
```yaml
board:
  name: holyiot_dongle_1k
  full_name: Holyiot YJ-16019 nRF52840 Dongle
  vendor: holyiot
  socs:
  - name: nrf52840
```

## config/boards/arm/nrf52840_mdk_dongle/Kconfig.defconfig
```kconfig
# nRF52840-MDK board configuration
#
# Copyright (c) 2021 Adam BZH (bzhthedeveloper@gmail.com)
# SPDX-License-Identifier: Apache-2.0

if BOARD_NRF52840_MDK_DONGLE

config BOARD
	default "nrf52840_mdk_dongle"

config SOC_NRF52840_QIAA
	default y

config BT_CTLR
	default BT

endif # BOARD_NRF52840_MDK_DONGLE
```

## config/boards/arm/nrf52840_mdk_dongle/board.yml
```yaml
board:
  name: nrf52840_mdk_dongle
  full_name: nRF52840 MDK USB Dongle (ZMK)
  vendor: makerdiary
  socs:
  - name: nrf52840
```

## config/boards/shields/Test/Kconfig.shield
```kconfig
config SHIELD_ROBA_R
    def_bool $(shields_list_contains,roBa_R)

config SHIELD_ROBA_L
    def_bool $(shields_list_contains,roBa_L)

config SHIELD_ROBA_R_PERIPHERAL
    def_bool $(shields_list_contains,roBa_R_peripheral)

config SHIELD_ROBA_DONGLE
    def_bool $(shields_list_contains,roBa_dongle)
```

## config/boards/shields/charybdis/Kconfig.defconfig
```kconfig
if SHIELD_CHARYBDIS_RIGHT

config ZMK_KEYBOARD_NAME
    default "Charybdis"

config ZMK_SPLIT
    default y

config ZMK_SPLIT_ROLE_CENTRAL
    default y

endif

if SHIELD_CHARYBDIS_RIGHT_PERIPHERAL

config ZMK_KEYBOARD_NAME
    default "Charybdis"

config ZMK_SPLIT
    default y

endif

if SHIELD_CHARYBDIS_NICE_NANO_DONGLE

config ZMK_KEYBOARD_NAME
    default "Charybdis Dongle"

config ZMK_SPLIT
    default y

config ZMK_SPLIT_ROLE_CENTRAL
    default y

config ZMK_SPLIT_BLE_CENTRAL_PERIPHERALS
    default 2

config BT_MAX_CONN
    default 7

config BT_MAX_PAIRED
    default 7

endif

if SHIELD_CHARYBDIS_LEFT

config ZMK_KEYBOARD_NAME
    default "Charybdis L"

config ZMK_SPLIT
    default y

endif
```

## config/boards/shields/charybdis/Kconfig.shield
```kconfig
config SHIELD_CHARYBDIS_RIGHT
    def_bool $(shields_list_contains,charybdis_right)

config SHIELD_CHARYBDIS_LEFT
    def_bool $(shields_list_contains,charybdis_left)

config SHIELD_CHARYBDIS_RIGHT_PERIPHERAL
    def_bool $(shields_list_contains,charybdis_right_peripheral)

config SHIELD_CHARYBDIS_NICE_NANO_DONGLE
    def_bool $(shields_list_contains,charybdis_nice_nano_dongle)
```

## config/boards/shields/charybdis_dongle/Kconfig.defconfig
```kconfig
if SHIELD_CHARYBDIS_DONGLE

config ZMK_KEYBOARD_NAME
    default "Charybdis NN"

config ZMK_SPLIT
    default y

config ZMK_SPLIT_ROLE_CENTRAL
    default y

config ZMK_SPLIT_BLE_CENTRAL_PERIPHERALS
    default 2

config BT_MAX_CONN
    default 7

config BT_MAX_PAIRED
    default 7

endif

if SHIELD_CHARYBDIS_DONGLE_LEFT

config ZMK_KEYBOARD_NAME
    default "Charybdis L"

config ZMK_SPLIT
    default y

endif

if SHIELD_CHARYBDIS_DONGLE_RIGHT

config ZMK_KEYBOARD_NAME
    default "Charybdis R"

config ZMK_SPLIT
    default y

endif
```

## config/boards/shields/charybdis_esb/boards/holyiot_dongle_1k.conf
```kconfig
# The Holyiot dongle has no OLED — turn the display subsystem off (the
# central shield's charybdis_esb.conf enables it for the nice!nano dongle).
CONFIG_ZMK_DISPLAY=n
CONFIG_ZMK_DISPLAY_STATUS_SCREEN_CUSTOM=n
CONFIG_ROBA_DONGLE_BATTERY_DISPLAY=n
```

## config/boards/shields/corne_esb/Kconfig.defconfig
```kconfig
if SHIELD_CORNE_ESB

config ZMK_KEYBOARD_NAME
    default "Corne ESB"

config ZMK_SPLIT
    default y

endif # SHIELD_CORNE_ESB

if SHIELD_CORNE_ESB_LEFT

config ZMK_KEYBOARD_NAME
    default "Corne ESB L"

config ZMK_SPLIT
    default y

endif # SHIELD_CORNE_ESB_LEFT

if SHIELD_CORNE_ESB_RIGHT

config ZMK_KEYBOARD_NAME
    default "Corne ESB R"

config ZMK_SPLIT
    default y

endif # SHIELD_CORNE_ESB_RIGHT

if SHIELD_CORNE_ESB_RIGHT_CIRQUE

config ZMK_KEYBOARD_NAME
    default "Corne ESB RC"

config ZMK_SPLIT
    default y

endif # SHIELD_CORNE_ESB_RIGHT_CIRQUE

if SHIELD_CORNE_ESB_LARISKA

config ZMK_KEYBOARD_NAME
    default "Corne ESB Lariska"

config ZMK_SPLIT
    default y

endif # SHIELD_CORNE_ESB_LARISKA
```

## config/boards/shields/corne_esb/Kconfig.shield
```kconfig
config SHIELD_CORNE_ESB
    def_bool $(shields_list_contains,corne_esb)

config SHIELD_CORNE_ESB_LEFT
    def_bool $(shields_list_contains,corne_esb_left)

config SHIELD_CORNE_ESB_RIGHT
    def_bool $(shields_list_contains,corne_esb_right)

config SHIELD_CORNE_ESB_RIGHT_CIRQUE
    def_bool $(shields_list_contains,corne_esb_right_cirque)

config SHIELD_CORNE_ESB_LARISKA
    def_bool $(shields_list_contains,corne_esb_lariska)
```

## config/boards/shields/corne_esb/boards/holyiot_dongle_1k.conf
```kconfig
# The Holyiot dongle has no OLED — turn the display subsystem off (the
# central shield's corne_esb.conf enables it for the nice!nano dongle).
CONFIG_ZMK_DISPLAY=n
CONFIG_ZMK_DISPLAY_STATUS_SCREEN_CUSTOM=n
CONFIG_ROBA_DONGLE_BATTERY_DISPLAY=n

# No OLED here, so the RGB LED is the only status indicator: layer color plus
# a per-peripheral low-battery blink (red=left, green=right, blue=lariska).
CONFIG_ROBA_PERIPHERAL_BATTERY_LED=y
CONFIG_ROBA_PERIPHERAL_BATTERY_LED_THRESHOLD=25
CONFIG_ROBA_LAYER_LED=y
```

## config/boards/shields/lariska_esb/Kconfig.defconfig
```kconfig
if SHIELD_LARISKA_ESB

config ZMK_KEYBOARD_NAME
    default "Lariska ESB"

config ZMK_SPLIT
    default y

endif
```

## config/boards/shields/roBa/Kconfig.defconfig
```kconfig
if SHIELD_ROBA_R

config ZMK_KEYBOARD_NAME
    default "roBa_R"

config ZMK_SPLIT
    default y

config ZMK_SPLIT_ROLE_CENTRAL
    default y

endif

if SHIELD_ROBA_R_PERIPHERAL

config ZMK_KEYBOARD_NAME
    default "roBa_R"

config ZMK_SPLIT
    default y

endif

if SHIELD_ROBA_DONGLE

config ZMK_KEYBOARD_NAME
    default "roBa Dongle"

config ZMK_SPLIT
    default y

config ZMK_SPLIT_ROLE_CENTRAL
    default y

config ZMK_SPLIT_BLE_CENTRAL_PERIPHERALS
    default 2

config BT_MAX_CONN
    default 7

config BT_MAX_PAIRED
    default 7

endif

if SHIELD_ROBA_NICE_NANO_DONGLE

config ZMK_KEYBOARD_NAME
    default "roBa NN Dongle"

config ZMK_SPLIT
    default y

config ZMK_SPLIT_ROLE_CENTRAL
    default y

config ZMK_SPLIT_BLE_CENTRAL_PERIPHERALS
    default 2

config BT_MAX_CONN
    default 7

config BT_MAX_PAIRED
    default 7

endif

if SHIELD_ROBA_DONGLE_MDK

config ZMK_KEYBOARD_NAME
    default "roBa Dongle"

config ZMK_SPLIT
    default y

config ZMK_SPLIT_ROLE_CENTRAL
    default y

config ZMK_SPLIT_BLE_CENTRAL_PERIPHERALS
    default 2

config BT_MAX_CONN
    default 7

config BT_MAX_PAIRED
    default 7

endif

if SHIELD_ROBA_L

config ZMK_KEYBOARD_NAME
    default "roBa_L"

config ZMK_SPLIT
    default y

endif

if SHIELD_ROBA_R_DEBUG

config ZMK_KEYBOARD_NAME
    default "roBa R Debug"

endif

if SHIELD_ROBA_L_ENC_INV

config ZMK_KEYBOARD_NAME
    default "roBa_L"

config ZMK_SPLIT
    default y

endif
```

## config/boards/shields/roBaesb/Kconfig.defconfig
```kconfig
if SHIELD_ROBAESB

config ZMK_KEYBOARD_NAME
    default "roBa ESB"

config ZMK_SPLIT
    default y

config ZMK_SPLIT_ROLE_CENTRAL
    default y

config ZMK_SPLIT_BLE_CENTRAL_PERIPHERALS
    default 2

config BT_MAX_PAIRED
    default 2

endif

if SHIELD_ROBAESB_LEFT

config ZMK_KEYBOARD_NAME
    default "roBa ESB L"

config ZMK_SPLIT
    default y

endif

if SHIELD_ROBAESB_RIGHT

config ZMK_KEYBOARD_NAME
    default "roBa ESB R"

config ZMK_SPLIT
    default y

endif

if SHIELD_ROBAESB_LEFT_ENC_INV

config ZMK_KEYBOARD_NAME
    default "roBa ESB L"

config ZMK_SPLIT
    default y

endif

if SHIELD_ROBAESB_BLE_RIGHT

config ZMK_KEYBOARD_NAME
    default "roBa ESB BLE R"

config ZMK_SPLIT
    default y

config ZMK_SPLIT_ROLE_CENTRAL
    default y

config ZMK_SPLIT_BLE_CENTRAL_PERIPHERALS
    default 1

config BT_MAX_PAIRED
    default 2

endif

if SHIELD_ROBAESB_BLE_LEFT

config ZMK_KEYBOARD_NAME
    default "roBa ESB BLE L"

config ZMK_SPLIT
    default y

endif

if SHIELD_ROBAESB_BLE_LEFT_ENC_INV

config ZMK_KEYBOARD_NAME
    default "roBa ESB BLE L"

config ZMK_SPLIT
    default y

endif

if SHIELD_ROBAESB_DISPLAY

config ZMK_KEYBOARD_NAME
    default "roBa ESB"

config ZMK_SPLIT
    default y

config ZMK_SPLIT_ROLE_CENTRAL
    default y

config ZMK_SPLIT_BLE_CENTRAL_PERIPHERALS
    default 2

config BT_MAX_PAIRED
    default 2

if ZMK_DISPLAY

config I2C
    default y

config SSD1306
    default y

choice ZMK_DISPLAY_WORK_QUEUE
    default ZMK_DISPLAY_WORK_QUEUE_DEDICATED
endchoice

endif # ZMK_DISPLAY

if SSD1306

config LV_Z_VDB_SIZE
    default 64

config LV_DPI_DEF
    default 148

config LV_Z_BITS_PER_PIXEL
    default 1

choice LV_COLOR_DEPTH
    default LV_COLOR_DEPTH_1
endchoice

endif # SSD1306

endif # SHIELD_ROBAESB_DISPLAY

if SHIELD_ROBAESB_DISPLAY_BLE

config ZMK_KEYBOARD_NAME
    default "roBa BLE Dongle"

config ZMK_SPLIT
    default y

config ZMK_SPLIT_ROLE_CENTRAL
    default y

config ZMK_SPLIT_BLE_CENTRAL_PERIPHERALS
    default 2

config BT_MAX_PAIRED
    default 5

if ZMK_DISPLAY

config I2C
    default y

config SSD1306
    default y

choice ZMK_DISPLAY_WORK_QUEUE
    default ZMK_DISPLAY_WORK_QUEUE_DEDICATED
endchoice

endif # ZMK_DISPLAY

if SSD1306

config LV_Z_VDB_SIZE
    default 64

config LV_DPI_DEF
    default 148

config LV_Z_BITS_PER_PIXEL
    default 1

choice LV_COLOR_DEPTH
    default LV_COLOR_DEPTH_1
endchoice

endif # SSD1306

endif # SHIELD_ROBAESB_DISPLAY_BLE

if SHIELD_ROBAESB_BLE_LEFT_CENTRAL

config ZMK_KEYBOARD_NAME
    default "roBa BLE L"

config ZMK_SPLIT
    default y

config ZMK_SPLIT_ROLE_CENTRAL
    default y

config ZMK_SPLIT_BLE_CENTRAL_PERIPHERALS
    default 4

config BT_MAX_PAIRED
    default 5

endif # SHIELD_ROBAESB_BLE_LEFT_CENTRAL

if SHIELD_ROBAESB_BLE_LEFT_CENTRAL_ENC_INV

config ZMK_KEYBOARD_NAME
    default "roBa BLE L"

config ZMK_SPLIT
    default y

config ZMK_SPLIT_ROLE_CENTRAL
    default y

config ZMK_SPLIT_BLE_CENTRAL_PERIPHERALS
    default 4

config BT_MAX_PAIRED
    default 5

endif # SHIELD_ROBAESB_BLE_LEFT_CENTRAL_ENC_INV
```

## config/boards/shields/roBaesb/Kconfig.shield
```kconfig
config SHIELD_ROBAESB
    def_bool $(shields_list_contains,roBaesb)

config SHIELD_ROBAESB_LEFT
    def_bool $(shields_list_contains,roBaesb_left)

config SHIELD_ROBAESB_LEFT_ENC_INV
    def_bool $(shields_list_contains,roBaesb_left_enc_inv)

config SHIELD_ROBAESB_RIGHT
    def_bool $(shields_list_contains,roBaesb_right)
```

## config/boards/shields/roBakesb/Kconfig.defconfig
```kconfig
if SHIELD_ROBAKESB

config ZMK_KEYBOARD_NAME
    default "roBa KESB"

config ZMK_SPLIT
    default y

endif # SHIELD_ROBAKESB

if SHIELD_ROBAKESB_LEFT

config ZMK_KEYBOARD_NAME
    default "roBa KESB L"

config ZMK_SPLIT
    default y

endif # SHIELD_ROBAKESB_LEFT

if SHIELD_ROBAKESB_RIGHT

config ZMK_KEYBOARD_NAME
    default "roBa KESB R"

config ZMK_SPLIT
    default y

endif # SHIELD_ROBAKESB_RIGHT
```

## config/boards/shields/roBakesb/boards/holyiot_dongle_1k.conf
```kconfig
# The Holyiot dongle has no OLED; use its RGB LED as the status indicator.
CONFIG_ZMK_DISPLAY=n
CONFIG_ZMK_DISPLAY_STATUS_SCREEN_CUSTOM=n
CONFIG_ROBA_DONGLE_BATTERY_DISPLAY=n

CONFIG_ROBA_PERIPHERAL_BATTERY_LED=y
CONFIG_ROBA_PERIPHERAL_BATTERY_LED_THRESHOLD=25
CONFIG_ROBA_LAYER_LED=y
```

## config/boards/shields/roBakesb/boards/nice_nano.conf
```kconfig
CONFIG_ZMK_DISPLAY=y
CONFIG_ZMK_DISPLAY_WORK_QUEUE_DEDICATED=y
# Turn the OLED off after 5 minutes of inactivity (key events received over ESB
# keep activity ACTIVE; IDLE then blanks/powers off the panel).
CONFIG_ZMK_DISPLAY_BLANK_ON_IDLE=y
CONFIG_ZMK_IDLE_TIMEOUT=300000
CONFIG_DISPLAY_INIT_PRIORITY=95
CONFIG_ZMK_DISPLAY_DEDICATED_THREAD_STACK_SIZE=4096
```

## config/boards/shields/roBakesb/boards/nice_nano_nrf52840_zmk.conf
```kconfig
CONFIG_ZMK_DISPLAY=y
# Dedicated display thread: if the display path hangs, it must not take the
# system work queue (USB, input processing) down with it.
CONFIG_ZMK_DISPLAY_WORK_QUEUE_DEDICATED=y
CONFIG_ZMK_DISPLAY_DEDICATED_THREAD_STACK_SIZE=4096
# Generous LVGL heap to rule out OOM looping (default is only 4096).
CONFIG_LV_Z_MEM_POOL_SIZE=16384
# Canonical mono-OLED LVGL config — matches every upstream ZMK 0.4 SSD1306
# shield (e.g. splitkb_aurora Kconfig.defconfig). 1-bit rendering enables
# ZMK's mono theme and sizes buffers correctly for the conversion path.
CONFIG_LV_COLOR_DEPTH_1=y
CONFIG_LV_Z_BITS_PER_PIXEL=1
CONFIG_LV_Z_VDB_SIZE=64
CONFIG_LV_DPI_DEF=148

# Custom roBa status screen: per-peripheral battery + connection + layer.
CONFIG_ZMK_DISPLAY_STATUS_SCREEN_CUSTOM=y
CONFIG_ROBA_DONGLE_BATTERY_DISPLAY=y
CONFIG_LV_FONT_DEFAULT_MONTSERRAT_12=y
# Turn the OLED off after 5 minutes of inactivity. The central raises
# zmk_position_state_changed for every key event received from the peripherals
# over ESB, which keeps activity in the ACTIVE state; after IDLE_TIMEOUT with no
# such events ZMK transitions to IDLE and blanks (powers off) the SH1106 panel.
CONFIG_ZMK_DISPLAY_BLANK_ON_IDLE=y
CONFIG_ZMK_IDLE_TIMEOUT=300000
# Init the OLED late so the ext-power rail (POST_KERNEL 81 + 50ms delay) has
# fully stabilized; the working main-branch display_ble build needed this too.
CONFIG_DISPLAY_INIT_PRIORITY=95
```
